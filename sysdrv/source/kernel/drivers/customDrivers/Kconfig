## sysdrv/source/kernel/drivers/customDrivers/Kconfig
```kconfig
menuconfig CUSTOM_DRIVERS
    tristate "Custom Drivers"
    default y
    
if CUSTOM_DRIVERS

source "drivers/customDrivers/oled/Kconfig"

endif
```

## sysdrv/source/kernel/drivers/customDrivers/oled/Kconfig
```kconfig
config OLED
    tristate "old driver"
    help
        oled driver.
    default y
```
